## zephyr/dts/bindings/st,st25r/st,st25r-common.yaml
```yaml
# Copyright © 2023 Vouch.io LLC
#
# SPDX-License-Identifier: Apache-2.0

properties:
  
  irq-gpios:
    type: phandle-array
    required: false # poll interrupt registers if not specified
    description: IRQ pin (active high)
```
